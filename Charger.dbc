VERSION ""

NS_ :

BS_:

BU_: EPIT_Gateway EPIT
VAL_TABLE_ vtbSensorReqCause 15 "SNA" 2 "by Request 2" 1 "by Request 1" 0 "normal cycle" ;
VAL_TABLE_ vtbErrorDescription 255 "ERROR" ;

BO_ 4 m_EPIT_FinishCharge: 1 EPIT
 SG_ s_EPIT_FinishCharge : 0|1@1+ (1,0) [0|1] ""  EPIT_Gateway

BO_ 3 m_EPIT_BatteryInfo: 2 EPIT
 SG_ s_ChargeValue : 0|16@1+ (1,0) [0|65535] ""  EPIT_Gateway

BO_ 2 m_Vehicle_BatteryInfo: 1 EPIT_Gateway
 SG_ s_SoC : 0|7@1+ (1,0) [0|127] ""  EPIT

BO_ 1 m_Vehicle_UserInfo: 4 EPIT_Gateway
 SG_ s_AccountNumber : 16|16@1+ (1,0) [0|65535] ""  EPIT
 SG_ s_CarNumber : 0|16@1+ (1,0) [0|65535] ""  EPIT

BO_ 0 m_EPIT_WaitConnect: 1 EPIT
 SG_ s_EPIT_Connect : 0|16@1+ (1,0) [0|1] ""  EPIT_Gateway

BA_DEF_  "Manufacturer" STRING ;
BA_DEF_ BU_  "NodeLayerModules" STRING ;
BA_DEF_  "BusType" STRING ;
BA_DEF_ SG_  "GenSigSendType" ENUM  "Cyclic","OnWrite","OnWriteWithRepetition","OnChange","OnChangeWithRepetition","IfActive","IfActiveWithRepetition","NoSigSendType","NotUsed","NotUsed","NotUsed","NotUsed","NotUsed";
BA_DEF_ BO_  "GenMsgSendType" ENUM  "Cyclic","NotUsed","NotUsed","NotUsed","NotUsed","Cyclic","NotUsed","IfActive","NoMsgSendType","NotUsed","vector_leerstring";
BA_DEF_ BO_  "GenMsgCycleTime" INT 0 50000;
BA_DEF_ BO_  "GenMsgCycleTimeFast" INT 0 50000;
BA_DEF_ BO_  "GenMsgILSupport" ENUM  "No","Yes";
BA_DEF_DEF_  "Manufacturer" "Vector";
BA_DEF_DEF_  "NodeLayerModules" "CANoeILNLVector.dll";
BA_DEF_DEF_  "BusType" "CAN";
BA_DEF_DEF_  "GenSigSendType" "Cyclic";
BA_DEF_DEF_  "GenMsgSendType" "NoMsgSendType";
BA_DEF_DEF_  "GenMsgCycleTime" 200;
BA_DEF_DEF_  "GenMsgCycleTimeFast" 20;
BA_DEF_DEF_  "GenMsgILSupport" "Yes";
